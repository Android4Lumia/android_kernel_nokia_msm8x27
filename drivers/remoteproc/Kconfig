## drivers/remoteproc/Kconfig
```kconfig
menu "Remoteproc drivers (EXPERIMENTAL)"

# REMOTEPROC gets selected by whoever wants it
config REMOTEPROC
	tristate
	depends on EXPERIMENTAL

config OMAP_REMOTEPROC
	tristate "OMAP remoteproc support"
	depends on ARCH_OMAP4
	depends on OMAP_IOMMU
	select REMOTEPROC
	select OMAP_MBOX_FWK
	select RPMSG
	help
	  Say y here to support OMAP's remote processors (dual M3
	  and DSP on OMAP4) via the remote processor framework.

	  Currently only supported on OMAP4.

	  Usually you want to say y here, in order to enable multimedia
	  use-cases to run on your platform (multimedia codecs are
	  offloaded to remote DSP processors using this framework).

	  It's safe to say n here if you're not interested in multimedia
	  offloading or just want a bare minimum kernel.

config QCOM_WCNSS_PIL
	tristate "Qualcomm WCNSS Peripheral Image Loader"
	#depends on ARCH_QCOM
	select QCOM_MDT_LOADER
	select QCOM_SCM
	select REMOTEPROC
	help
	  Say y here to support the Peripherial Image Loader for the Qualcomm
	  Wireless Connectivity Subsystem.

endmenu
```
